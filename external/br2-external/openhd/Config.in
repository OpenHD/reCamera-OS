## external/br2-external/openhd/Config.in
```kconfig
config BR2_PACKAGE_OPENHD
    bool "openhd"
    select BR2_PACKAGE_LIBPCAP
    select BR2_PACKAGE_POCO
    select BR2_PACKAGE_LIBSODIUM
    select BR2_PACKAGE_GSTREAMER1
    select BR2_PACKAGE_GST1_PLUGINS_BASE
    select BR2_PACKAGE_GST1_PLUGINS_BASE_PLUGIN_APP
    depends on BR2_PACKAGE_POCO_VERSION_1_13_2
    help
      OpenHD package
```

## external/br2-external/rtl8812eu-openhd/Config.in
```kconfig
config BR2_PACKAGE_RTL88x2EU_OPENHD
	bool "RTL88x2EU-openhd"
	depends on BR2_LINUX_KERNEL
	help
	  A standalone driver for the RTL88x2EU / RTL8821AU Dual Band
	  USB Wi-Fi adapter.

	  Make sure your target kernel has the CONFIG_WIRELESS_EXT
	  config option enabled.

	  Note: this package needs a firmware loading mechanism to
	  load the binary blob for the chip to work.

	  https://github.com/aircrack-ng/RTL88x2EU/

comment "RTL88x2EU needs a Linux kernel to be built"
	depends on !BR2_LINUX_KERNEL
```
